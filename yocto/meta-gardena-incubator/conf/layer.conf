## yocto/meta-gardena-incubator/conf/layer.conf
```bitbake
# We have a conf and classes directory, add to BBPATH
BBPATH .= ":${LAYERDIR}"

# We have recipes-* directories, add to BBFILES
BBFILES += "${LAYERDIR}/recipes-*/*/*.bb \
            ${LAYERDIR}/recipes-*/*/*.bbappend"

BBFILE_COLLECTIONS += "meta-gardena-incubator"
BBFILE_PATTERN_meta-gardena-incubator = "^${LAYERDIR}/"
BBFILE_PRIORITY_meta-gardena-incubator = "6"
LAYERSERIES_COMPAT_meta-gardena-incubator = "dunfell"
```

## yocto/meta-homekit/conf/layer.conf
```bitbake
# We have a conf and classes directory, add to BBPATH
BBPATH .= ":${LAYERDIR}"

# We have recipes-* directories, add to BBFILES
BBFILES += "${LAYERDIR}/recipes-*/*/*.bb \
            ${LAYERDIR}/recipes-*/*/*.bbappend"

BBFILE_COLLECTIONS += "meta-homekit"
BBFILE_PATTERN_meta-homekit = "^${LAYERDIR}/"
BBFILE_PRIORITY_meta-homekit = "6"
LAYERSERIES_COMPAT_meta-homekit = "dunfell zeus"
```

## yocto/meta-lemonbeat-firmware/conf/layer.conf
```bitbake
# We have a conf and classes directory, add to BBPATH
BBPATH .= ":${LAYERDIR}"

# We have recipes-* directories, add to BBFILES
BBFILES += "${LAYERDIR}/recipes-*/*/*.bb \
            ${LAYERDIR}/recipes-*/*/*.bbappend"

BBFILE_COLLECTIONS += "meta-lemonbeat-firmware"
BBFILE_PATTERN_meta-lemonbeat-firmware = "^${LAYERDIR}/"
BBFILE_PRIORITY_meta-lemonbeat-firmware = "6"
LAYERSERIES_COMPAT_meta-lemonbeat-firmware = "scarthgap"
```
